## bsp/ti/c28x/tms320f28379d/board/Kconfig
```kconfig
menu "Hardware Drivers Config"

menu "Onboard Peripheral Drivers"
endmenu

menu "On-chip Peripheral Drivers"
    config BSP_USING_FLASH
        bool "Using FLASH as CMD, default RAM"
        default n
    config BSP_USING_GPIO
        bool "Enable GPIO"
        select RT_USING_PIN
        default y
    menuconfig BSP_USING_XINT
        bool "Enable external interrupt"
        default n
        if BSP_USING_XINT
            menuconfig BSP_USING_XINT1
                bool "Enable XINT1"
                if BSP_USING_XINT1
                    config BSP_XINT1_PIN
                        int "Interrupt pin"
                        range 0 168
                        default 0
                endif
                if !BSP_USING_XINT1
                    config BSP_XINT1_PIN
                        int
                        default -1
                endif
            menuconfig BSP_USING_XINT2
                bool "Enable XINT2"
                if BSP_USING_XINT2
                    config BSP_XINT2_PIN
                        int "Interrupt pin"
                        range 0 168
                        default 0
                endif
                if !BSP_USING_XINT2
                    config BSP_XINT2_PIN
                        int
                        default -1
                endif
            menuconfig BSP_USING_XINT3
                bool "Enable XINT3"
                if BSP_USING_XINT3
                    config BSP_XINT3_PIN
                        int "Interrupt pin"
                        range 0 168
                        default 0
                endif
                if !BSP_USING_XINT3
                    config BSP_XINT3_PIN
                        int
                        default -1
                endif
            menuconfig BSP_USING_XINT4
                bool "Enable XINT4"
                if BSP_USING_XINT4
                    config BSP_XINT4_PIN
                        int "Interrupt pin"
                        range 0 168
                        default 0
                endif
                if !BSP_USING_XINT4
                    config BSP_XINT4_PIN
                        int
                        default -1
                endif
                if !BSP_USING_XINT5
                    config BSP_XINT5_PIN
                        int
                        default -1
                endif
            menuconfig BSP_USING_XINT5
                bool "Enable XINT5"
                if BSP_USING_XINT5
                    config BSP_XINT5_PIN
                        int "Interrupt pin"
                        range 0 168
                        default 0
                endif
        endif
    menuconfig BSP_USING_UART
        bool "Enable UART"
        default y
        select RT_USING_SERIAL
        if BSP_USING_UART
            config BSP_USING_UART1
                bool "Enable UART1"
                default y
        endif
    menuconfig BSP_USING_PWM
        bool "Enable PWM"
        default n
        select RT_USING_PWM

        if BSP_USING_PWM
            source "./kconfig_folder/PWM1_config"
            source "./kconfig_folder/PWM2_config"
            source "./kconfig_folder/PWM3_config"
            source "./kconfig_folder/PWM4_config"
            source "./kconfig_folder/PWM5_config"
            source "./kconfig_folder/PWM6_config"            
        endif

    menuconfig BSP_USING_ADC
        bool "Enable ADC"
        default n
        select RT_USING_ADC
        if BSP_USING_ADC
            menuconfig BSP_USING_ADC1
                bool "Enable ADC1"
                default n
                if BSP_USING_ADC1
                    choice
                        prompt "Select resolution"
                        default BSP_ADC_USING_12BIT

                        config BSP_ADC_USING_12BIT
                            bool "ADC Using 12 bit resolution"

                        config BSP_ADC_USING_16BIT
                            bool "ADC Using 16 bit resolution"
                    endchoice
                endif
            menuconfig BSP_USING_ADC2
                bool "Enable ADC2"
                default n
                if BSP_USING_ADC2
                    choice
                        prompt "Select resolution"
                        default BSP_ADC_USING_12BIT

                        config BSP_ADC_USING_12BIT
                            bool "ADC Using 12 bit resolution"

                        config BSP_ADC_USING_16BIT
                            bool "ADC Using 16 bit resolution"
                    endchoice
                endif
            menuconfig BSP_USING_ADC3
                bool "Enable ADC3"
                default n
                if BSP_USING_ADC3
                    choice
                        prompt "Select resolution"
                        default BSP_ADC_USING_12BIT

                        config BSP_ADC_USING_12BIT
                            bool "ADC Using 12 bit resolution"

                        config BSP_ADC_USING_16BIT
                            bool "ADC Using 16 bit resolution"
                    endchoice
                endif
        endif

    menuconfig BSP_USING_ONCHIP_RTC
        bool "Enable RTC"
        select RT_USING_RTC
        default n
        if BSP_USING_ONCHIP_RTC
            choice
                prompt "Select clock source"
                default BSP_RTC_USING_LSE

                config BSP_RTC_USING_LSE
                    bool "RTC USING LSE"

                config BSP_RTC_USING_LSI
                    bool "RTC USING LSI"
            endchoice
        endif

    config BSP_USING_WDT
        bool "Enable Watchdog Timer"
        select RT_USING_WDT
        default n

    config BSP_USING_SDIO
        bool "Enable SDIO"
        select RT_USING_SDIO
        select RT_USING_DFS
        default n

    menuconfig BSP_USING_CAN
        bool "Enable CAN"
        default n
        select RT_USING_CAN
        if BSP_USING_CAN
            config BSP_USING_CAN1
                bool "using CAN1"
                default n
        endif

    config BSP_USING_USBD
        bool "Enable USB device"
        select RT_USING_USB_DEVICE
        default n
        if BSP_USING_USBD
            config BSP_USB_CONNECT_PIN
                int "USB connect pin"
                default 67

            config BSP_USB_PULL_UP_STATUS
                int "USB PULL UP STATUS"
                default 0
        endif
endmenu

menu "Board extended module Drivers"

endmenu

endmenu
```
